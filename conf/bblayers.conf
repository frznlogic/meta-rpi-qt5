## conf/bblayers.conf
```bitbake
# LAYER_CONF_VERSION is increased each time build/conf/bblayers.conf
# changes incompatibly
LCONF_VERSION = "5"

BBPATH = "${TOPDIR}"
BBFILES ?= ""

BSPDIR := "${@os.path.abspath(os.path.dirname(d.getVar('FILE', True)) + '/../..')}"

BBLAYERS ?= " \
  ${BSPDIR}/sources/poky/meta \
  ${BSPDIR}/sources/poky/meta-yocto \
  ${BSPDIR}/sources/poky/meta-yocto-bsp \
  ${BSPDIR}/sources/meta-raspberrypi \
  ${BSPDIR}/sources/meta-qt6 \
  ${BSPDIR}/sources/meta-openembedded/meta-oe \
  ${BSPDIR}/sources/meta-openembedded/meta-networking \
  ${BSPDIR}/sources/meta-openembedded/meta-python \
  ${BSPDIR}/sources/meta-openembedded/meta-systemd \
  ${BSPDIR}/sources/meta-openembedded/meta-ruby \
  ${BSPDIR}/sources/meta-frozenmirror \
"

BBLAYERS_NON_REMOVABLE ?= " \
  ${BSPDIR}/sources/poky/meta \
  ${BSPDIR}/sources/poky/meta-yocto \
  "
```

## conf/distro/rpi-wayland-qt5.conf
```bitbake
DISTRO_NAME = "rpi-qt5-wayland"
DISTRO_VERSION = "0.5"

DISTRO_FEATURES_append = " opengl wayland qt5 systemd gles2 "

VIRTUAL-RUNTIME_init_manager = "systemd"

DISTRO_EXTRA_RDEPENDS_append = ""

DISTRO_EXTRA_RRECOMMENDS_append = "" 

TCLIBC_append = "" 

include rpi-hwup-image.bb
```

## conf/distro/rpi-wayland-qt6.conf
```bitbake
DISTRO_NAME = "rpi-qt6-wayland"
DISTRO_VERSION = "0.5"

DISTRO_FEATURES:append = " opengl qt6 systemd gles2 "


VIRTUAL-RUNTIME_init_manager = "systemd"

DISTRO_EXTRA_RDEPENDS:append = ""

DISTRO_EXTRA_RRECOMMENDS:append = "" 

TCLIBC:append = "" 

include rpi-hwup-image.bb
```

## conf/layer.conf
```bitbake
# We have a conf and classes directory, add to BBPATH
BBPATH .= ":${LAYERDIR}"

# We have recipes-* directories, add to BBFILES
BBFILES += "${LAYERDIR}/recipes-*/*/*.bb \
	${LAYERDIR}/recipes-*/*/*.bbappend"

BBFILE_COLLECTIONS += "meta-rpi-qt5"
BBFILE_PATTERN_meta-rpi-qt5 = "^${LAYERDIR}/"
BBFILE_PRIORITY_meta-rpi-qt5 = "8"
```
